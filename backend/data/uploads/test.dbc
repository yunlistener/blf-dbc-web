VERSION ""

NS_ :

BS_:

BU_ : ECU

BO_ 291 EngineData: 8 ECU
 SG_ EngineSpeed : 16|16@1+ (0.125,0) [0|8000] "rpm" ECU
 SG_ CoolantTemp : 8|8@1+ (1,-40) [-40|215] "degC" ECU

BO_ 292 VehicleSpeed: 8 ECU
 SG_ VehicleSpeed : 0|16@1+ (0.01,0) [0|655.35] "km/h" ECU

VAL_ 291 EngineSpeed 0 "Off" 1 "On";
